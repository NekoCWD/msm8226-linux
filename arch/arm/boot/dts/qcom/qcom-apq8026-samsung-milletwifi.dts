// SPDX-License-Identifier: BSD-3-Clause
/*
 * Samsung millet WiFi device tree
 *
 * Copyright (c) 2022, Matti Lehtimäki <matti.lehtimaki@gmail.com>
 * Copyright (c) 2023, Bryant Mairs <bryant@mai.rs>
 * Copyright (c) 2024, NekoCWD <nekodevelopper@gmail.com>
 */

#include "qcom-apq8026-samsung-millet-common.dtsi"

/ {
	model = "Samsung Galaxy Tab 4 8.0 Wi-Fi";
	compatible = "samsung,milletwifi", "qcom,apq8026";
};